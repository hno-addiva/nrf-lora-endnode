## boards/shields/semtech_sx1261mb2bas/Kconfig.defconfig
```kconfig
# Copyright (c) 2022 Addiva Elektronik AB
# Copyright (c) 2020 Lemonbeat GmbH (semtech_sx1272mb2das)
# SPDX-License-Identifier: Apache-2.0

if SHIELD_SEMTECH_SX1261MB2BAS

if LORA

config SPI
	default y

endif # LORA

endif # SHIELD_SEMTECH_SX1261MB2BAS
```

## boards/shields/semtech_sx1261mb2bas/Kconfig.shield
```kconfig
# Copyright (c) 2022 Addiva Elektronik AB
# SPDX-License-Identifier: Apache-2.0

config SHIELD_SEMTECH_SX1261MB2BAS
	def_bool $(shields_list_contains,semtech_sx1261mb2bas)
```

## boards/shields/semtech_sx1276mb1mas/Kconfig.shield
```kconfig
# Copyright (c) 2022 Addiva Elektronik AB
# Copyright (c) 2020 Lemonbeat GmbH (semtech_sx1272mb2das)
# SPDX-License-Identifier: Apache-2.0

config SHIELD_SEMTECH_SX1276MB1MAS
	def_bool $(shields_list_contains,semtech_sx1276mb1mas)
```
